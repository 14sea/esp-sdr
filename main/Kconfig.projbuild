## main/Kconfig.projbuild
```kconfig
menu "ESP-SDR transport"

    config ESP_SDR_TRANSPORT_ETHERNET
        depends on !IDF_TARGET_ESP32S31
        bool "Ethernet (HTTP control and UDP IQ)"
        default y
        help
            Use the onboard YT8531 RGMII Ethernet PHY. The board obtains
            its IPv4 address through DHCP and advertises esp-sdr.local.

    config ESP_SDR_TRANSPORT_USB
        depends on !IDF_TARGET_ESP32S31
        bool "USB (vendor control and bulk IQ)"
        help
            Use the native high-speed USB-OTG device port with the
            vendor-specific ESP-SDR control and IQ protocol. Ethernet and USB
            may be enabled together; the most recently started stream owns the
            shared receive engine.

    config ESP_SDR_UART_ENABLED
        bool "Burst UART0 I/Q transport" if !IDF_TARGET_ESP32
        depends on IDF_TARGET_ESP32C3 || IDF_TARGET_ESP32 || IDF_TARGET_ESP32S2 || IDF_TARGET_ESP32S3 || IDF_TARGET_ESP32C61 || IDF_TARGET_ESP32C6 || IDF_TARGET_ESP32S31
        default y
        help
            Enable the optional USB-to-UART bridge interface. Disable it to
            leave the UART GPIOs unused by the application. Native USB remains
            available on chips that support it. The original ESP32 requires UART.

    config ESP_SDR_UART_BAUD
        int "Burst UART0 I/Q baud rate"
        depends on IDF_TARGET_ESP32C3 || IDF_TARGET_ESP32 || IDF_TARGET_ESP32S2 || IDF_TARGET_ESP32S3 || IDF_TARGET_ESP32C61 || IDF_TARGET_ESP32C6 || IDF_TARGET_ESP32S31
        range 115200 3000000
        default 2000000
        help
            The burst I/Q protocol is also available on UART0, 8N1, without
            hardware flow control. The browser baud rate must match this value.

    config ESP_SDR_UART_TX_PIN
        int "Burst UART0 TX GPIO"
        depends on IDF_TARGET_ESP32C3 || IDF_TARGET_ESP32 || IDF_TARGET_ESP32S2 || IDF_TARGET_ESP32S3 || IDF_TARGET_ESP32C61 || IDF_TARGET_ESP32C6 || IDF_TARGET_ESP32S31
        range 0 48 if !IDF_TARGET_ESP32S31
        range 0 63 if IDF_TARGET_ESP32S31
        default 1 if IDF_TARGET_ESP32
        default 21 if IDF_TARGET_ESP32C3
        default 58 if IDF_TARGET_ESP32S31
        default 16 if IDF_TARGET_ESP32C6
        default 11 if IDF_TARGET_ESP32C61
        default 43

    config ESP_SDR_UART_RX_PIN
        int "Burst UART0 RX GPIO"
        depends on IDF_TARGET_ESP32C3 || IDF_TARGET_ESP32 || IDF_TARGET_ESP32S2 || IDF_TARGET_ESP32S3 || IDF_TARGET_ESP32C61 || IDF_TARGET_ESP32C6 || IDF_TARGET_ESP32S31
        range 0 48 if !IDF_TARGET_ESP32S31
        range 0 63 if IDF_TARGET_ESP32S31
        default 3 if IDF_TARGET_ESP32
        default 20 if IDF_TARGET_ESP32C3
        default 59 if IDF_TARGET_ESP32S31
        default 17 if IDF_TARGET_ESP32C6
        default 10 if IDF_TARGET_ESP32C61
        default 44

endmenu
```
